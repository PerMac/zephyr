## samples/subsys/testsuite/pytest/shell/testcase.yaml
```yaml
tests:
  sample.pytest.shell:
    filter: CONFIG_SERIAL and dt_chosen_enabled("zephyr,shell-uart")
    min_ram: 40
    tags: shell
    harness: pytest
    extra_configs:
      - CONFIG_NATIVE_UART_0_ON_STDINOUT=y
```

## tests/ztest/mcuboot/misc/testcase.yaml
```yaml
common:
  timeout: 9999
  tags: mcuboot misc

tests:
  mcuboot.misc.overwrite:
    multi_build:
      - name: bootloader
        path: ../../../../../bootloader/mcuboot/boot/zephyr
        extra_args: OVERLAY_CONFIG=../../samples/zephyr/overlay-upgrade-only.conf
      - name: hello1
        path: ../hello-world
        extra_args: FROM_WHO=hello1
      - name: hello2
        path: ../hello-world
        extra_args: FROM_WHO=hello2
    integration_platforms:
      - nrf52dk_nrf52832
    stages:
      - WestSign:
          image: hello1
          key: ../bootloader/mcuboot/root-rsa-2048.pem
      - WestSign:
          image: hello2
          key: ../bootloader/mcuboot/root-rsa-2048.pem
          pad: true
          hex_addr: "0x73000"
      - OnTarget:
          image: bootloader
          harness: console
          harness_config:
            type: multi_line
            regex:
              - "Starting bootloader"
              - "Boot source: none"
              - "Unable to find bootable image"
      - OnTarget:
          image: hello1
          harness: console
          harness_config:
            type: multi_line
            regex:
              - "Starting bootloader"
              - "Swap type: none"
              - "Bootloader chainload address offset: 0xc000"
              - "Jumping to the first image slot"
              - "Hello World from hello1"
      - OnTarget:
          image: hello2
          harness: console
          harness_config:
            type: multi_line
            regex:
              - "Starting bootloader"
              - "Swap type: test"
              - "Image upgrade secondary slot -> primary slot"
              - "Erasing the primary slot"
              - "Copying the secondary slot to the primary slot: 0x4638 bytes"
              - "Bootloader chainload address offset: 0xc000"
              - "Jumping to the first image slot"
              - "Hello World from hello2"
      - OnTarget:
          command: "pyocd commander -c reset"
          harness: console
          harness_config:
            type: multi_line
            regex:
              - "Starting bootloader"
              - "Swap type: none"
              - "Bootloader chainload address offset: 0xc000"
              - "Jumping to the first image slot"
              - "Hello World from hello2"

  mcuboot.rsa.no_bootcheck:
    multi_build:
      - name: bootloader
        path: ../../../../../bootloader/mcuboot/boot/zephyr
        extra_args: OVERLAY_CONFIG=../../samples/zephyr/overlay-skip-primary-slot-validate.conf
      - name: hello1
        path: ../hello-world
        extra_args: FROM_WHO=hello1
      - name: hello2
        path: ../hello-world
        extra_args: FROM_WHO=hello2
    integration_platforms:
      - nrf52dk_nrf52832
    stages:
      - WestSign:
          image: hello1
          key: ../bootloader/mcuboot/root-ec-p256.pem
      - WestSign:
          image: hello2
          key: ../bootloader/mcuboot/root-ec-p256.pem
          pad: true
          hex_addr: "0x73000"
      - OnTarget:
          image: bootloader
          harness: console
          harness_config:
            type: multi_line
            regex:
              - "Starting bootloader"
              - "Primary image: magic=unset, swap_type=0x1, copy_done=0x3, image_ok=0x3"
              - "Secondary image: magic=unset, swap_type=0x1, copy_done=0x3, image_ok=0x3"
              - "Boot source: none"
              - "Failed reading image headers; Image=0"
              - "bad image magic 0x200019b0; Image=0"
              - "Unable to find bootable image"
      - OnTarget:
          image: hello1
          harness: console
          harness_config:
            type: multi_line
            regex:
              - "Starting bootloader"
              - "Primary image: magic=unset, swap_type=0x1, copy_done=0x3, image_ok=0x3"
              - "Secondary image: magic=unset, swap_type=0x1, copy_done=0x3, image_ok=0x3"
              - "Boot source: none"
              - "Swap type: none"
              - "Bootloader chainload address offset: 0xc000"
              - "Jumping to the first image slot"
              - "Hello World from hello1"
      - OnTarget:
          image: hello2
          harness: console
          harness_config:
            type: multi_line
            regex:
              - "Starting bootloader"
              - "Primary image: magic=unset, swap_type=0x1, copy_done=0x3, image_ok=0x3"
              - "Secondary image: magic=good, swap_type=0x1, copy_done=0x3, image_ok=0x3"
              - "Boot source: none"
              - "Swap type: test"
              - "Image in the secondary slot is not valid!"
              - "Bootloader chainload address offset: 0xc000"
              - "Jumping to the first image slot"
              - "Hello World from hello1"
      - OnTarget:
          command: "pyocd commander -c reset"
          harness: console
          harness_config:
            type: multi_line
            regex:
              - "Starting bootloader"
              - "Primary image: magic=unset, swap_type=0x1, copy_done=0x3, image_ok=0x3"
              - "Secondary image: magic=unset, swap_type=0x1, copy_done=0x3, image_ok=0x3"
              - "Boot source: none"
              - "Swap type: none"
              - "Bootloader chainload address offset: 0xc000"
              - "Jumping to the first image slot"
              - "Hello World from hello1"
```

## tests/ztest/multi_build/tests/testcase.yaml
```yaml
common:
  timeout: 9999
  tags: mcuboot rsa
  multi_build:
    - name: bootloader
      path: ../../../../../bootloader/mcuboot/boot/zephyr
      extra_args: OVERLAY_CONFIG=../../samples/zephyr/overlay-rsa.conf
    - name: hello1
      path: ../hello-world
      extra_args: FROM_WHO=hello1
    - name: hello2
      path: ../hello-world
      extra_args: FROM_WHO=hello2

tests:
  mcuboot.rsa.good:
    integration_platforms:
      - nrf52dk_nrf52832
    stages:
      #- CallScripts:
      #  - "/home/maciej/zephyrproject2/bootloader/mcuboot/scripts/imgtool.py sign \
      #   --key /home/maciej/zephyrproject2/bootloader/mcuboot/root-rsa-2048.pem \
      #    --header-size 0x200 \
      #    --align 8 \
      #    --version 1.2 \
      #    --slot-size 0x67000 \
      #    /home/maciej/zephyrproject2/zephyr/twister-out/nrf52840dk_nrf52840/tests/ztest/multi_build/tests/mcuboot.rsa.good/hello1/zephyr/zephyr.hex \
      #    /home/maciej/zephyrproject2/zephyr/twister-out/nrf52840dk_nrf52840/tests/ztest/multi_build/tests/mcuboot.rsa.good/hello1/zephyr/zephyr.hex
      #    "

      - WestSign:
          image: hello1
          key: /home/maciej/zephyrproject2/bootloader/mcuboot/root-rsa-2048.pem
      - WestSign:
          image: hello2
          key: /home/maciej/zephyrproject2/bootloader/mcuboot/root-rsa-2048.pem
          pad: true
          hex_addr: "0x73000"
      - OnTarget:
          image: bootloader
          harness: console
          harness_config:
            type: multi_line
            regex:
              - "Starting bootloader"
              - "Primary image: magic=unset, swap_type=0x1, copy_done=0x3, image_ok=0x3"
              - "Secondary image: magic=unset, swap_type=0x1, copy_done=0x3, image_ok=0x3"
              - "Boot source: none"
              - "Failed reading image headers; Image=0"
              - "Unable to find bootable image"
      - OnTarget:
          image: hello1
          harness: console
          harness_config:
            type: multi_line
            regex:
              - "Starting bootloader"
              - "Primary image: magic=unset, swap_type=0x1, copy_done=0x3, image_ok=0x3"
              - "Secondary image: magic=unset, swap_type=0x1, copy_done=0x3, image_ok=0x3"
              - "Boot source: none"
              - "Swap type: none"
              - "Bootloader chainload address offset:" # for nrf52840 0xc000
              - "Jumping to the first image slot"
              - "Hello World from hello1"
      - OnTarget:
          image: hello2
          harness: console
          harness_config:
            type: multi_line
            regex:
              - "Starting bootloader"
              - "Primary image: magic=unset, swap_type=0x1, copy_done=0x3, image_ok=0x3"
              - "Secondary image: magic=good, swap_type=0x1, copy_done=0x3, image_ok=0x3"
              - "Boot source: none"
              - "Swap type: test"
              - "Bootloader chainload address offset:" # for nrf52840 0xc000
              - "Jumping to the first image slot"
              - "Hello World from hello2"
  mcuboot.rsa.incorrect:
    integration_platforms:
      - nrf52dk_nrf52832
    stages:
      - WestSign:
          image: hello1
          key: /home/maciej/zephyrproject2/bootloader/mcuboot/root-rsa-2048.pem
      - WestSign:
          image: hello2
          key: /home/maciej/zephyrproject2/bootloader/mcuboot/samples/zephyr/bad-keys/bad-rsa-2048.pem
          pad: true
          hex_addr: "0x73000"
      - OnTarget:
          image: bootloader
          harness: console
          harness_config:
            type: multi_line
            regex:
              - "Starting bootloader"
              - "Primary image: magic=unset, swap_type=0x1, copy_done=0x3, image_ok=0x3"
              - "Secondary image: magic=unset, swap_type=0x1, copy_done=0x3, image_ok=0x3"
              - "Boot source: none"
              - "Failed reading image headers; Image=0"
              - "Unable to find bootable image"
      - OnTarget:
          image: hello1
          harness: console
          harness_config:
            type: multi_line
            regex:
              - "Starting bootloader"
              - "Primary image: magic=unset, swap_type=0x1, copy_done=0x3, image_ok=0x3"
              - "Secondary image: magic=unset, swap_type=0x1, copy_done=0x3, image_ok=0x3"
              - "Boot source: none"
              - "Swap type: none"
              - "Bootloader chainload address offset:" # for nrf52840 0xc000
              - "Jumping to the first image slot"
              - "Hello World from hello1"
      - OnTarget:
          image: hello2
          harness: console
          harness_config:
            type: multi_line
            regex:
              - "Starting bootloader"
              - "Primary image: magic=unset, swap_type=0x1, copy_done=0x3, image_ok=0x3"
              - "Secondary image: magic=good, swap_type=0x1, copy_done=0x3, image_ok=0x3"
              - "Boot source: none"
              - "Swap type: test"
              - "Bootloader chainload address offset:" # for nrf52840 0xc000
              - "Jumping to the first image slot"
              - "Hello World from hello2"
```
